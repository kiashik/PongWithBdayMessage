/*Pong game with Birthday Wish
 * Button 2:  UP_BUTTON:
* In modePage, single click = play pong.
* Improvements: in messages, single click = next message.
* Button 3: DOWN_BUTTON: 
* In modePage, single click = play pong.
* Improvements: in messages, single click = prev message.
* Button 4: MODE :
* In modePage, single click = play messages.
* In messages, single click to return to modePage.
* In pongMode, single click MODE button to return to modePage.
* NEED TO ADD THE BDAY MESSAGES AND OTHER MEESAGES AS A SEPARATE FUNCTIONS.
 */
#include <Wire.h>
#include <Adafruit_GFX.h>
#include <Adafruit_SSD1306.h>

#define SCREEN_WIDTH 128 // OLED display width, in pixels
#define SCREEN_HEIGHT 64 // OLED display height, in pixels

// Declaration for an SSD1306 display connected to I2C (SDA, SCL pins)
// The pins for I2C are defined by the Wire-library. 
// On an arduino UNO:       A4(SDA), A5(SCL)
// On an arduino MEGA 2560: 20(SDA), 21(SCL)
// On an arduino LEONARDO:   2(SDA),  3(SCL), ...
#define OLED_RESET     -1 // Reset pin # (or -1 if sharing Arduino reset pin)
#define SCREEN_ADDRESS 0x3C ///< See datasheet for Address; 0x3D for 128x64, 0x3C for 128x32
Adafruit_SSD1306 display(SCREEN_WIDTH, SCREEN_HEIGHT, &Wire, OLED_RESET);

#define modeButton 4
long buttonTimer = 0;
long longPressTime = 2000;
bool buttonActive = false;
bool longPressActive = false;

byte mode = 0; // 0 = modePage, 1 = Pong, 2= Messages
bool leaveModePage = false; 
const int message_num = 0; //0 is birthday. add more later if you please. 

/////////----------Birthday below------------//////////////////////////////////////////
#define NUMFLAKES     10 // Number of snowflakes in the animation example

#define LOGO_HEIGHT   16
#define LOGO_WIDTH    16
static const unsigned char PROGMEM logo_bmp[] =
{ 0b00000000, 0b11000000,
  0b00000001, 0b11000000,
  0b00000001, 0b11000000,
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  0b00000000, 0b00110000 };
  

  char message1a[] = "Happy Birthday";
  char message1b[] = " to You!";
  char message2[] = "  Dear Nam! ";

  
//////-----Birthday above-----/////////////////////////////////////////////////
//////-----Pong below-----/////////////////////////////////////////////////
#include <SPI.h>
#define UP_BUTTON 2
#define DOWN_BUTTON 3

const unsigned long PADDLE_RATE = 33;
const unsigned long BALL_RATE = 20;
const uint8_t PADDLE_HEIGHT = 24;
int MAX_SCORE = 3;

int CPU_SCORE = 0;
int PLAYER_SCORE = 0;

void drawCourt();

uint8_t ball_x = 64, ball_y = 32;
uint8_t ball_dir_x = 1, ball_dir_y = 1;

boolean gameIsRunning = true;
boolean resetBall = false;

static const unsigned char pong []PROGMEM = {
0xff,0xe0,0x0,0x3f,0x80,0x7,0xe0,0x7,0xc0,0x3,0xfc,0x0,
0xff,0xf8,0x1,0xff,0xe0,0x7,0xf0,0x7,0xc0,0x1f,0xff,0x0,
0xff,0xfc,0x3,0xff,0xf0,0x7,0xf0,0x7,0xc0,0x3f,0xff,0x0,
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0xf8,0x0,0x0,0x7f,0x0,0x7,0xc0,0xf,0xc0,0x7,0xf8,0x0
};

static const unsigned char game []PROGMEM ={
0x0,0x0,0x0,0x0,0x0,0x0,0x0,0x0,0x0,0x80,
0x0,0x0,0x0,0x0,0x0,0x0,0x0,0x1,0xff,0x80,
0x0,0x0,0x0,0x0,0x0,0x0,0x0,0xc3,0xff,0x80,
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0x7,0xfc,0x0,0x0,0x0,0x0,0x0,0x0,0x0,0x0
};

unsigned long ball_update;
unsigned long paddle_update;
const uint8_t CPU_X = 12;
uint8_t cpu_y = 16;

const uint8_t PLAYER_X = 115;  //85 is the small version
uint8_t player_y = 16;
//////-----Pong above-----/////////////////////////////////////////////////
// 'modePage', 128x64px
const unsigned char myBitmapmodePage [] PROGMEM = {
 0x00, 0x00, 0x00, 0x00, 0x00, 0x00, 0x00, 0x00, 0x00, 0x00, 0x00, 0x00, 0x00, 0x00, 0x00, 0x00, 
  0x00, 0x00, 0x00, 0x00, 0x00, 0x00, 0x00, 0x00, 0x00, 0x00, 0x00, 0x00, 0x00, 0x00, 0x00, 0x00, 
  0x00, 0x00, 0x00, 0x00, 0x00, 0x00, 0x00, 0x00, 0x00, 0x00, 0x00, 0x00, 0x00, 0x00, 0x00, 0x00, 
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  0x00, 0x00, 0x00, 0x00, 0x00, 0x00, 0x00, 0x00, 0x00, 0x00, 0x00, 0x00, 0x00, 0x00, 0x00, 0x00
};

const unsigned char mybitmapfood [] PROGMEM = {
  0xff, 0xff, 0xff, 0xff, 0xff, 0xff, 0xff, 0xff, 0xff, 0xff, 0xff, 0xff, 0xff, 0x98, 0xfe, 0x8f, 
  0xff, 0xff, 0xff, 0xff, 0xff, 0xff, 0xff, 0xff, 0xff, 0xff, 0xff, 0xff, 0xff, 0x91, 0xfd, 0x8f, 
  0xff, 0xff, 0xff, 0xff, 0xff, 0xff, 0xff, 0xff, 0xff, 0xff, 0xff, 0xff, 0xff, 0x07, 0xf8, 0x7f, 
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  0xff, 0xff, 0xff, 0xff, 0xb8, 0xfe, 0xff, 0xff, 0xff, 0xff, 0xff, 0xff, 0xf9, 0xe6, 0x24, 0x07
};

const unsigned char mybitmaptwo [] PROGMEM = {
  0xff, 0xff, 0xff, 0xff, 0xff, 0xff, 0xff, 0xff, 0xff, 0xff, 0xff, 0xfc, 0xff, 0xff, 0xff, 0xff, 
  0xff, 0xff, 0xff, 0xff, 0xff, 0xff, 0xff, 0xff, 0xff, 0xff, 0xff, 0xf9, 0xff, 0xff, 0xff, 0xff, 
  0xff, 0xff, 0xff, 0xff, 0xff, 0xff, 0xff, 0xff, 0xff, 0xff, 0xff, 0xf3, 0xff, 0xff, 0xff, 0xff, 
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  0xff, 0xff, 0xff, 0xff, 0xff, 0xff, 0xff, 0xff, 0xff, 0xff, 0xff, 0xff, 0xff, 0xff, 0xff, 0xff
};
const unsigned char mybitmapgroot [] PROGMEM = {
  0xff, 0xff, 0xff, 0xff, 0xfc, 0x3f, 0xff, 0xff, 0xff, 0xfc, 0x03, 0xff, 0xff, 0xff, 0xff, 0xff, 
  0xff, 0xff, 0xff, 0xff, 0xfe, 0x7f, 0xff, 0xff, 0xff, 0xff, 0xe3, 0xff, 0xff, 0xff, 0xff, 0xff, 
  0xff, 0xff, 0xff, 0xff, 0x1f, 0xff, 0xff, 0xfc, 0x7f, 0xff, 0xe3, 0xff, 0xff, 0xff, 0xff, 0xff, 
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  0xff, 0xff, 0xff, 0xff, 0xff, 0xff, 0xff, 0x90, 0x3f, 0xff, 0xff, 0xff, 0xff, 0xff, 0xff, 0xff
};
const unsigned char mybitmaplala [] PROGMEM = {
  0x00, 0x00, 0x00, 0x00, 0x1f, 0xff, 0xff, 0xff, 0xff, 0xff, 0xff, 0xff, 0xff, 0xff, 0xff, 0xff, 
  0x00, 0x00, 0x00, 0x00, 0x3f, 0xff, 0xff, 0xff, 0xff, 0xff, 0xff, 0xff, 0xff, 0xff, 0xff, 0xff, 
  0x00, 0x00, 0x00, 0x03, 0xff, 0xff, 0xff, 0xff, 0xff, 0xff, 0xff, 0xff, 0xff, 0xff, 0xff, 0xff, 
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  0x8f, 0xf7, 0xff, 0xff, 0xff, 0xff, 0xff, 0xff, 0xff, 0xff, 0xff, 0xff, 0xff, 0xff, 0xff, 0xff
};
const unsigned char mybitmapbutter [] PROGMEM = {
  0xff, 0xff, 0xff, 0xff, 0xff, 0xff, 0xff, 0xff, 0xff, 0xff, 0xff, 0xff, 0xff, 0xff, 0xff, 0xff, 
  0xff, 0xff, 0xff, 0xff, 0xff, 0xff, 0xff, 0xff, 0xff, 0xff, 0xff, 0xff, 0xff, 0xff, 0xff, 0xff, 
  0xff, 0xff, 0xff, 0xff, 0xff, 0xff, 0xff, 0xff, 0xff, 0xff, 0xff, 0xff, 0xff, 0xff, 0xff, 0xff, 
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  0xff, 0xff, 0xff, 0xff, 0xff, 0xff, 0xff, 0xff, 0xff, 0xff, 0xff, 0xff, 0xff, 0xff, 0xff, 0xff
};

const unsigned char mybitmapbro [] PROGMEM = {
  0xff, 0xff, 0xff, 0xff, 0xff, 0xff, 0xff, 0xff, 0xff, 0xff, 0xff, 0xff, 0xff, 0xff, 0xff, 0xff, 
  0xff, 0xff, 0xff, 0xff, 0xff, 0xff, 0xff, 0xff, 0xff, 0xff, 0xff, 0xff, 0xff, 0xff, 0xff, 0xff, 
  0xff, 0xff, 0xff, 0xff, 0xff, 0xff, 0xff, 0xff, 0xff, 0xff, 0xff, 0xff, 0xff, 0xff, 0xff, 0xff, 
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  0xff, 0xff, 0xff, 0xff, 0xff, 0xff, 0xff, 0xff, 0xff, 0xff, 0xff, 0xff, 0xff, 0xff, 0xff, 0xff
};
const unsigned char mybitmapashik [] PROGMEM = {
  0x9b, 0xf9, 0x66, 0x00, 0x14, 0x00, 0x00, 0x00, 0x00, 0x01, 0xf0, 0x00, 0x00, 0x00, 0x00, 0x00, 
  0x3f, 0xb1, 0x4f, 0x00, 0x3e, 0x00, 0x00, 0x00, 0x00, 0x01, 0xf0, 0x00, 0x00, 0x00, 0x00, 0x00, 
  0xf8, 0x03, 0xcf, 0xc0, 0x3e, 0x00, 0x00, 0x00, 0x00, 0x01, 0xf0, 0x00, 0x00, 0x00, 0x00, 0x00, 
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  0x05, 0xcc, 0x78, 0xff, 0x00, 0x00, 0x00, 0x00, 0x00, 0x00, 0x00, 0x00, 0x00, 0x00, 0x00, 0x00
};


 void setup() {
    pinMode(modeButton, INPUT);
    pinMode(UP_BUTTON, INPUT);
    pinMode(DOWN_BUTTON, INPUT);
    Serial.begin(9600);
    Serial.println("begin");

      // SSD1306_SWITCHCAPVCC = generate display voltage from 3.3V internally
    if(!display.begin(SSD1306_SWITCHCAPVCC, SCREEN_ADDRESS)) {
      Serial.println(F("SSD1306 allocation failed"));
      for(;;); // Don't proceed, loop forever
    }
  
    // Show initial display buffer contents on the screen --
    // the library initializes this with an Adafruit splash screen.
    display.display();
    delay(1000); // Pause for 2 seconds for adafruit logo
    display.clearDisplay();
    
    display.setTextSize(1);       
    display.setTextColor(SSD1306_WHITE);   
    display.setCursor(5,5);       
    display.print(F("Ashik's doing"));      //"Ashik's doing"
    display.display();
    delay(250);
    dotdotdot();               //"Ashik's doing." "Ashik's doing." "Ashik's doing..."
    delay(1200);
    
    //instructions
    display.clearDisplay();
    display.setTextSize(1);       
    display.setTextColor(SSD1306_WHITE);   
    display.setCursor(0,6);       
    display.print(F("Don't click till Home"));      //instructions
    display.display(); delay(400);
    
    display.setTextSize(1);       
    display.setTextColor(SSD1306_WHITE);   
    display.setCursor(0,17);       
    display.print(F("Clk Mode for Txt. ClkUp for Pong. During  Pong or after BD, clkMode to return home. Clk Down for pic."));      //instructions
    display.display(); delay(10300);


    
}

void loop() {
    if (mode == 0) {
        Serial.println("mode 0: modePage");
        modePage();
    } else if (mode == 1) {
        Serial.println("mode 1: PONG");
        pongMode();
    } else if (mode == 2) {
      Serial.println("mode 2: Messages");
      messages();
    } else {
        mode = 0;
        Serial.println("mode x: else");
    }


} //Void lopp ends here

//----------Display functions----------------------
void modePage(void) {
   
  display.setTextSize(2);       
  display.setCursor(48,44);
  display.clearDisplay();
  display.drawBitmap(0, 0, myBitmapmodePage, 128, 64, WHITE);
  display.display(); 
  delay(200);
  
  leaveModePage = false; 
  while (!leaveModePage) {
      if (digitalRead(modeButton)) {
        mode = 2; leaveModePage = !leaveModePage;
      }
      if  (digitalRead(UP_BUTTON) || digitalRead(DOWN_BUTTON)) {
        mode = 1; leaveModePage = !leaveModePage; 
      }
  }             //while
                  
} /////////////////////////////////////////////////////
void dotdotdot(void) {
  display.print(F("."));          //"."
  display.display();
  delay(250);
  display.print(F("."));          //".."
  display.display();
  delay(250);
  display.print(F("."));          //"..."
  display.display();
  delay(250);
}/////////////////////////////////////////////////////
//--------pongMode--------------------------------
void pongMode(void){
  display.clearDisplay();
  display.drawBitmap(3,0,pong,89,24,BLACK);
  display.drawBitmap(10,30,game,75,26,WHITE);

  unsigned long start = millis();
  display.clearDisplay();
  drawCourt();

  while(millis() - start < 2000);

  display.display();

  ball_update = millis();
  paddle_update = ball_update;
  ball_x = random(25,65); 
  ball_y = random(3,63);    //setup complete here

  while (mode != 0) {
    Serial.println("------------entered while--------");
     bool update = false;    //purpose is to know when to refresh display
    unsigned long time = millis();

    static bool up_state = false;
    static bool down_state = false;
    
    up_state |= (digitalRead(UP_BUTTON) == LOW);
    down_state |= (digitalRead(DOWN_BUTTON) == LOW);

    if(resetBall)
    {
      ball_x = random(25,70); 
      ball_y = random(3,63);
      do
      {
      ball_dir_x = random(-1,2);
      }while(ball_dir_x==0);

       do
      {
      ball_dir_y = random(-1,2);
      }while(ball_dir_y==0);
      
      
      resetBall=false;
    }
    
    if(time > ball_update && gameIsRunning) {
        uint8_t new_x = ball_x + ball_dir_x;
        uint8_t new_y = ball_y + ball_dir_y;

        // Check if we hit the vertical walls
        if(new_x == 0) //Player Gets a Point
        {
            PLAYER_SCORE++;
            if(PLAYER_SCORE==MAX_SCORE)
            {
              gameOver();
            }else
            {
              showScore();
            }
        }

         // Check if we hit the vertical walls
        if(new_x == 125) //CPU Gets a Point
        {
            CPU_SCORE++;
            if(CPU_SCORE==MAX_SCORE)
            {
              gameOver();
            }else
            {
              showScore();
            }
        }

        // Check if we hit the horizontal walls.
        if(new_y == 0 || new_y == 63) {
            ball_dir_y = -ball_dir_y;
            new_y += ball_dir_y + ball_dir_y;
        }

        // Check if we hit the CPU paddle
        if(new_x == CPU_X && new_y >= cpu_y && new_y <= cpu_y + PADDLE_HEIGHT) {
            ball_dir_x = -ball_dir_x;
            new_x += ball_dir_x + ball_dir_x;
        }

        // Check if we hit the player paddle
        if(new_x == PLAYER_X
           && new_y >= player_y
           && new_y <= player_y + PADDLE_HEIGHT)
        {
            ball_dir_x = -ball_dir_x;
            new_x += ball_dir_x + ball_dir_x;
        }

        display.drawPixel(ball_x, ball_y, BLACK);
        display.drawPixel(new_x, new_y, WHITE);
        ball_x = new_x;
        ball_y = new_y;

        ball_update += BALL_RATE;

    }

    if(time > paddle_update && gameIsRunning) {
        paddle_update += PADDLE_RATE;

        // CPU paddle
        display.drawFastVLine(CPU_X, cpu_y,PADDLE_HEIGHT, BLACK); 
        const uint8_t half_paddle = PADDLE_HEIGHT >> 1;
        if(cpu_y + half_paddle > ball_y) {
            cpu_y -= 1;
        }
        if(cpu_y + half_paddle < ball_y) {
            cpu_y += 1;
        }
        if(cpu_y < 1) cpu_y = 1;
        if(cpu_y + PADDLE_HEIGHT > 63) cpu_y = 63 - PADDLE_HEIGHT;
        display.drawFastVLine(CPU_X, cpu_y, PADDLE_HEIGHT, WHITE); 

        // Player paddle
        display.drawFastVLine(PLAYER_X, player_y,PADDLE_HEIGHT, BLACK); 
        if(up_state) {
            player_y -= 1;
        }
        if(down_state) {
            player_y += 1;
        }
        up_state = down_state = false;
        if(player_y < 1) player_y = 1;
        if(player_y + PADDLE_HEIGHT > 63) player_y = 63 - PADDLE_HEIGHT;
        display.drawFastVLine(PLAYER_X, player_y, PADDLE_HEIGHT, WHITE);

        update = true;
    }

    if(update)
        display.display();


    if (digitalRead(modeButton)) { // In pongMode, single click MODE button to return to modePage.
      mode = 0; 
    }

  }
  Serial.println("//////exited while/////////");  
}
///////////////////////////////////////////////////////
void drawCourt() {
    display.drawRect(0, 0, 128, 64, WHITE);
    display.display();
}
//-------gameOver--------------------------------------
void gameOver()
{
  gameIsRunning = false;
  display.fillScreen(BLACK);
  drawCourt();
  if(PLAYER_SCORE>CPU_SCORE)
  {
    display.setCursor(5,4);
    display.setTextColor(WHITE);
    display.setTextSize(2);
    display.print("You Won"); display.display();
  }else
  {
    display.setCursor(5,4);
    display.setTextColor(WHITE);
    display.setTextSize(2);
    display.print("CPU WON"); display.display();
  }

  display.setCursor(20,30);
  display.setTextColor(WHITE);
  display.setTextSize(3);
  display.print(String(CPU_SCORE)); display.display();

  display.setCursor(60,30);
  display.setTextColor(WHITE);
  display.setTextSize(3);
  display.print(String(PLAYER_SCORE)); display.display();
  
  delay(5000);

  while(digitalRead(UP_BUTTON) == HIGH && digitalRead(DOWN_BUTTON) == HIGH)  
  {
    delay(100);
  }
  gameIsRunning = true;
  
  CPU_SCORE = PLAYER_SCORE = 0;
  
  unsigned long start = millis();
 display.fillScreen(BLACK);
 drawCourt();
  while(millis() - start < 2000);
  ball_update = millis();    
  paddle_update = ball_update;
  gameIsRunning = true;
  resetBall=true;
  
  mode=0;         //will return to modePage after gameover
}////////////////////////////////////////////////////////
//--------showScore---------------------------------------
void showScore()
{
    gameIsRunning = false;
    display.fillScreen(BLACK);
    drawCourt();
    
    display.setCursor(15,4);
    display.setTextColor(WHITE);
    display.setTextSize(2);
    display.print("Score"); display.display();
  
    display.setCursor(20,30);
    display.setTextColor(WHITE);
    display.setTextSize(3);
    display.print(String(CPU_SCORE)); display.display();
  
    display.setCursor(60,30);
    display.setTextColor(WHITE);
    display.setTextSize(3);
    display.print(String(PLAYER_SCORE)); display.display();
  
   delay(2000);
   unsigned long start = millis();
  
   display.fillScreen(BLACK);
   drawCourt();
  while(millis() - start < 2000);
  ball_update = millis();    
  paddle_update = ball_update;
  gameIsRunning = true;
  resetBall=true;
}///////////////////////////////////////////
//-----------messages--------------------
void messages(void){
  Serial.println("entering messages------------");
  happyBDayFull();

//  leaveModePage = false; 
//  while (!leaveModePage) { Serial.println("entering message while------------");
//    if (digitalRead(modeButton)) {
//      mode = 0; leaveModePage = !leaveModePage;
//    }
//  }             //while
//  Serial.println("EXITED message while------------");
  
}//////////////////////////////////////////////////

//------------happyBDayFull-------------------------
void happyBDayFull(void) {
  display.clearDisplay();

  intro();
  display.clearDisplay();
  
  display.setTextSize(1);       
  display.setTextColor(SSD1306_WHITE);   
  display.setCursor(23,20);       
  fadeText(message1a);
  display.setCursor(35,30);       
  fadeText(message1b);
  delay(1000);
  display.clearDisplay();

  display.setCursor(23,20);       
  fadeText(message1a);
  display.setCursor(35,30);       
  fadeText(message1b);
  delay(1000);
  display.clearDisplay();

  display.setCursor(23,20);       
  display.print(F("Happy Birthday"));
  display.setTextColor(SSD1306_BLACK, SSD1306_WHITE);       
  display.setCursor(28,30);
  fadeText(message2);
  delay(1500);
  display.clearDisplay();

  display.drawBitmap(0, 0, mybitmapfood, 128, 64, WHITE);
  display.display();
  delay(2000);
   
  testanimate(logo_bmp, LOGO_WIDTH, LOGO_HEIGHT); // Animate bitmaps
  //new addtions-------------
  delay(10);
  mode = 1;
  int pick_pic = 0;
  display.clearDisplay(); // Clear the display buffer
  while(mode != 0) { // Loop forever...
    if (digitalRead(modeButton)) {
      mode=0;
    }
    

  if (digitalRead(DOWN_BUTTON)) {
      pick_pic = pick_pic+1;
      if (pick_pic >= 7){
        pick_pic = 0;
      }
    }
    
  if (pick_pic == 0){
      display.clearDisplay(); // Clear the display buffer
      display.drawBitmap(0, 0, mybitmapfood, 128, 64, WHITE);
  } else if (pick_pic ==1) {
    display.clearDisplay(); // Clear the display buffer
    display.drawBitmap(0, 0, mybitmaptwo, 128, 64, WHITE);
  } else if (pick_pic ==2) {
    display.clearDisplay(); // Clear the display buffer
    display.drawBitmap(0, 0, mybitmapgroot, 128, 64, WHITE);
  } else if (pick_pic ==3) {
    display.clearDisplay(); // Clear the display buffer
    display.drawBitmap(0, 0, mybitmaplala, 128, 64, WHITE);
  } else if (pick_pic ==4) {
    display.clearDisplay(); // Clear the display buffer
    display.drawBitmap(0, 0, mybitmapbutter, 128, 64, WHITE);
  } else if (pick_pic ==5) {
    display.clearDisplay(); // Clear the display buffer
    display.drawBitmap(0, 0, mybitmapbro, 128, 64, WHITE);
  } else if (pick_pic ==6) {
    display.clearDisplay(); // Clear the display buffer
    display.drawBitmap(0, 0, mybitmapashik, 128, 64, WHITE);
  } 
  else {
    pick_pic = 0;
  }
  display.display();
  delay(100);
      
  }// while(mode !=0)
  
  ///------------------
}

void fadeText(String txt){
  int num = txt.length();
  
  for (int i=0; i<num; i++){
    char letter = txt[i];
    display.print(String(letter));
    display.display();
    delay(40);
  }
  
  
}

void intro(void) {
  display.setTextSize(1);       
  display.setTextColor(SSD1306_WHITE);   
  display.setCursor(5,5);       
  display.print(F("Bday"));      //"Bday"
  display.display();
  delay(250);
  dotdotdot();               //"Bday." "Bday." "Bday..."
  
  display.setTextSize(3);       
  display.setCursor(50,25);       
  
  display.print(F("3"));        //"3"
  display.display();
  delay(250);
  display.setTextSize(1);       
  display.setCursor(48,44);
  dotdotdot();               //"3." "3." "3..."
                   
  display.clearDisplay();

  display.setCursor(5,5);       
  display.print(F("Bday..."));      //"begin"
  display.setTextSize(3);       
  display.setCursor(50,25);
  display.print(F("2"));        //"2"
  display.display();
  delay(250);
  display.setTextSize(1);       
  display.setCursor(48,44);
  dotdotdot();               //"2." "1." "1..."                
  display.clearDisplay();

  display.setCursor(5,5);       
  display.print(F("Bday..."));      //"begin"
  display.setTextSize(3);       
  display.setCursor(50,25);
  display.print(F("1"));        //"1"
  display.display();
  delay(250);
  display.setTextSize(1);       
  display.setCursor(48,44);
  dotdotdot();               //"1." "1." "1..."                   
  display.clearDisplay();  
} /////////////////////////////////////////////////////
//---------------testanimate(.......)------------------

#define XPOS   0 // Indexes into the 'icons' array in function below
#define YPOS   1
#define DELTAY 2

void testanimate(const uint8_t *bitmap, uint8_t w, uint8_t h) {
  int8_t f, icons[NUMFLAKES][3];

  // Initialize 'snowflake' positions
  for(f=0; f< NUMFLAKES; f++) {
    icons[f][XPOS]   = random(1 - LOGO_WIDTH, display.width());
    icons[f][YPOS]   = -LOGO_HEIGHT;
    icons[f][DELTAY] = random(1, 6);
    Serial.print(F("x: "));
    Serial.print(icons[f][XPOS], DEC);
    Serial.print(F(" y: "));
    Serial.print(icons[f][YPOS], DEC);
    Serial.print(F(" dy: "));
    Serial.println(icons[f][DELTAY], DEC);
  }

  while(mode != 0) { // Loop forever...
    display.clearDisplay(); // Clear the display buffer

    // Draw each snowflake:
    for(f=0; f< NUMFLAKES; f++) {
      display.drawBitmap(icons[f][XPOS], icons[f][YPOS], bitmap, w, h, SSD1306_WHITE);
    }

    display.display(); // Show the display buffer on the screen
    delay(200);        // Pause for 1/10 second

    // Then update coordinates of each flake...
    for(f=0; f< NUMFLAKES; f++) {
      icons[f][YPOS] += icons[f][DELTAY];
      // If snowflake is off the bottom of the screen...
      if (icons[f][YPOS] >= display.height()) {
        // Reinitialize to a random position, just off the top
        icons[f][XPOS]   = random(1 - LOGO_WIDTH, display.width());
        icons[f][YPOS]   = -LOGO_HEIGHT;
        icons[f][DELTAY] = random(1, 6);
      }
    }

  if (digitalRead(DOWN_BUTTON)) {
      mode = 0;
    }
      
  }// while(mode !=0)
} //////////////////////////////////////////////////////////////
